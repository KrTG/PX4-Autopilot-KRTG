## src/drivers/force/Kconfig
```kconfig
menu "force"
    menuconfig DRIVERS_FORCE
        bool "Common force"
        default n
        select DRIVERS_M5WEIGHT
        ---help---
            Enable default set of force sensors
    rsource "*/Kconfig"
endmenu #force
```

## src/drivers/force/m5weight/Kconfig
```kconfig
menuconfig DRIVERS_FORCE_M5WEIGHT
	bool "m5weight"
	default n
	---help---
		Enable support for m5weight
```

## src/drivers/hello/Kconfig
```kconfig
menuconfig DRIVERS_HELLO
	bool "hello"
	default n
	---help---
		Enable support for hello
```
